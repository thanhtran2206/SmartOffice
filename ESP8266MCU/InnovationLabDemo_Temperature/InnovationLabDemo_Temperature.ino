// Generated by Vorto from com.bosch.iotacademy.tutorial.SimpleIlluminance:1.0.0

#define USE_SECURE_CONNECTION 1

#include "DHTesp.h"
#include <PubSubClient.h>
#include <ESP8266WiFi.h>
#if (USE_SECURE_CONNECTION == 1)
    #include <WiFiClientSecure.h>
#endif
#include "src/model/functionblock/Illuminance.h"
#include "src/model/infomodel/SimpleIlluminance.h"

/**************************************************************************/
/* Sensor | Actuator inialization                                         */
/**************************************************************************/
#define DHTpin 14    //D5 of NodeMCU is GPIO14
DHTesp dht;

/**************************************************************************/
/* Configuration section, adjust to your settings                         */
/**************************************************************************/

#define tenantId "tbb53c83d08534d4bacd3b83d1588ae67_hub"

/* MQTT broker endpoint */
const char* hub_adapter_host = "mqtt.bosch-iot-hub.com";

#if (USE_SECURE_CONNECTION == 1)
	/* SHA-1 fingerprint of the server certificate of the MQTT broker, UPPERCASE and spacing */
	const char* mqttServerFingerprint = "12 EB 94 31 91 04 14 26 2A 7C 06 6F D2 6A 42 B8 22 44 20 BB";
#endif

/* Define the period of data transmission in ms */
#define MQTT_DATA_PERIOD 10000

/* Define the buffer size for payload strings */
#define MQTT_MAX_SIZE  50

/* Device Configuration */
String deviceId = "net.tranminhthanh.smartthing:device01";
String authId = "net.tranminhthanh.smartthing_device01";
const char* device_password = "thanh123";

/* Payload Configuration*/
String ditto_topic = "net.tranminhthanh.smartthing/device01";

/* WiFi Configuration */
const char* ssid = "JioFi_208D22D_TMT";
const char* password = "thanhtran2206";

/* BEGIN SAMPLE CODE */
/* dummy numeric */
long dummy_value = 0;

/* Sample text value */
char msg[MQTT_MAX_SIZE];
/* END SAMPLE CODE */

/**************************************************************************/
/* Implementation                                                         */
/**************************************************************************/

/* Port on which the MQTT broker is listening */
#if (USE_SECURE_CONNECTION == 1)
    #define MQTT_SERVER_PORT 8883
#else
    #define MQTT_SERVER_PORT 1883
#endif

/* Topic on which the telemetry data is published */
String telemetryTopic = String("telemetry/") + String(tenantId) + String("/");

/* This variables stores the client ID in the MQTT protocol */
String clientId;

/* Timestamp of previous data transmission */
long lastMqttMsg;

/* Setup WiFi mqttClient and MQTT mqttClient */
#if (USE_SECURE_CONNECTION == 1)
    WiFiClientSecure wifiClient;
#else
    WiFiClient wifiClient;
#endif
PubSubClient mqttClient(wifiClient);

/* The information model object */
com_bosch_iotacademy_tutorial::SimpleIlluminance infoModel;

/**************************************************************************/
/* Function to connect to the WiFi network                                */
/**************************************************************************/
void setup_wifi() {

    delay(10);
  
    /* We start by connecting to a WiFi network */
    Serial.print("Connecting to WiFi with SSID: ");
    Serial.println(ssid);
    WiFi.begin(ssid, password);

    /* Wait for succesful connection, hang if there is none? */
    while (WiFi.status() != WL_CONNECTED) {
    	Serial.print(".");
        delay(500);
    }

    randomSeed(micros());

    Serial.println("");
    Serial.println("WiFi connected");
    Serial.print("IP address: ");
    Serial.println(WiFi.localIP());
    Serial.print("MAC address: ");
    Serial.println(WiFi.macAddress());
}

/**************************************************************************/
/* Function called when data on a subscribed topic arrives                */
/**************************************************************************/
void mqttDataReceived(char* topic, byte* payload, unsigned int length) {
	
    /* BEGIN SAMPLE CODE */
     		 
    if ((char)payload[0] == '1') {		  	    
		Serial.println("MQTT Data sucessfully received"); 
    } else {		  	    
      	Serial.println("No MQTT Data reveived");
    }
    
    /* END SAMPE CODE */
}

/**************************************************************************/
/* Reconnect to MQTT broker in case the connection dropped                */
/**************************************************************************/
void reconnect() {
	String username = String(authId) + "@" + String(tenantId);
    /* Loop while not connected */
    while (!mqttClient.connected()) {		    

        /* If connected to the MQTT broker... */
        
        
        if (mqttClient.connect(clientId.c_str(),username.c_str(),device_password)) {
            /* Attempt to Connect succesfull */		            
            Serial.println("Successfully connected to MQTT Broker");
            /* SAMPLE CODE */
            //String topic = telemetryTopic + "/led";
            //mqttClient.subscribe(topic.c_str());		            
            /* END SAMPLE CODE */
        } else {
    	    /* otherwise wait for 5 seconds before retrying */
    	    Serial.println("Waiting for next attempt to connect to MQTT Broker");
            delay(5000);
        }
    }
}

/**************************************************************************/
/* Functions for publishing data using MQTT					              */
/**************************************************************************/

boolean publishIlluminance() {			
		String mqttPayload = infoModel.illuminance.serialize(ditto_topic ,deviceId, "illuminance");
	
		/* Debug output on console */
		Serial.print("Publishing Payload for illuminance: "); 
		Serial.print(mqttPayload);
		Serial.print(" to topic: "); 
		Serial.println(telemetryTopic);
	
		/* Publish all available illuminance data to the MQTT broker */
		if(!mqttClient.publish(telemetryTopic.c_str(), mqttPayload.c_str())) {		 	    
			Serial.println("Publish illuminance failed, if this happens repeatedly increase MQTT_MAX_PACKET_SIZE in PubSubClient.h");		 	    
			return false;
		} else {		 	    
			return true; 		  	
		}		 
}       	

/**************************************************************************/
/* Arduino Setup and Loop Functions							              */
/**************************************************************************/
void setup() {		    
    Serial.begin(115200);

    /* Set up sensor | actuator */ 
    dht.setup(DHTpin, DHTesp::DHT11);

    /* Set up WiFi */
    setup_wifi();
  
   /* Create a MQTT client ID */
    clientId = deviceId;
    
    Serial.print("Device ID: ");
    Serial.println(clientId);
    
    /* Add the device ID to the telemetry topic as the final element */
    telemetryTopic += deviceId;
  
    /* Configure the MQTT client with the server and callback data */
    mqttClient.setServer(hub_adapter_host, MQTT_SERVER_PORT);
    mqttClient.setCallback(mqttDataReceived);

    #if (USE_SECURE_CONNECTION == 1)
        if (!wifiClient.connect(hub_adapter_host, MQTT_SERVER_PORT)) {
        	Serial.println("Secure connection failed, restart Device");		            
	        ESP.restart();
        } else {
        	Serial.println("Successfully established secure connection to broker");
		}
		
        if (!wifiClient.verify(mqttServerFingerprint, hub_adapter_host)) {
            Serial.println("Verification failed, restart Device");	
	        ESP.restart();
        } else {
        	Serial.println("Successfully verified server certificate");
        }
    #endif
    
    /*Test MQQT Client*/
    mqttClient.publish("","");
}

void loop() {		
	/* Check if connection to MQTT broker is still good */
    if (!mqttClient.connected()) {
    	/* Reconnect if not */
        reconnect();
    }
    
    /* Event handling of the MQTT client */
    mqttClient.loop();

    /* Publish the telemetry data periodically */
    long now = millis();
    if (now - lastMqttMsg > MQTT_DATA_PERIOD) {
        lastMqttMsg = now;

        delay(dht.getMinimumSamplingPeriod());
        
        float humidity = dht.getHumidity();
        float temperature = dht.getTemperature();
        float illuminance = 0;

        Serial.print("Humidity: ");
        Serial.print(humidity);
        Serial.println("");
        Serial.print("Temperature: ");
        Serial.print(temperature);  
        Serial.println("");

        /* SAMPLE CODE */
        dummy_value++;
        snprintf(msg, MQTT_MAX_SIZE - 1, "hello world #%ld", dummy_value);
        
        //Status Properties
        	org_eclipse_vorto_types::SensorValue value;
        	value.setcurrentMeasured(temperature);
        	value.setminMeasured(dummy_value);
        	value.setmaxMeasured(dummy_value);
        	infoModel.illuminance.setvalue(value);
        
        publishIlluminance();
/* END OF SAMPLE CODE */
    }
}
